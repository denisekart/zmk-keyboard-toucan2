## config/west.yml
```yaml
manifest:
  defaults:
    revision: v0.3
  remotes:
    - name: zmkfirmware
      url-base: https://github.com/zmkfirmware
    - name: caksoylar
      url-base: https://github.com/caksoylar
    - name: geeksville
      url-base: https://github.com/geeksville
    - name: beekeeb
      url-base: https://github.com/beekeeb
    - name: urob
      url-base: https://github.com/urob
    - name: denisekart
      url-base: https://github.com/denisekart
  projects:
    - name: zmk
      remote: zmkfirmware
      import: app/west.yml
      revision: v0.3
    - name: zmk-rgbled-widget
      remote: caksoylar
      revision: v0.3
    - name: zmk_driver_azoteq
      remote: denisekart
      revision: master
    - name: zmk-input-zoom
      remote: beekeeb
      revision: main
    - name: zmk-adaptive-key
      remote: urob
    - name: zmk-auto-layer
      remote: urob
    - name: zmk-helpers
      remote: urob
    - name: zmk-leader-key
      remote: urob
  self:
    path: config
```
